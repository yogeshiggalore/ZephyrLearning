/ {
    gpiocustom {
        compatible = "gpio-keys";
        appled: appled_0 {
            gpios = <&gpio0 17 GPIO_ACTIVE_LOW>;
            label = "app led 0";
        };
    };
    aliases {
        appled = &appled;
    };
};